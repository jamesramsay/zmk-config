## config/west.yml
```yaml
manifest:
  remotes:
    - name: zmkfirmware
      url-base: https://github.com/zmkfirmware
    - name: jamesramsay
      url-base: https://github.com/jamesramsay
    - name: petejohanson
      url-base: https://github.com/petejohanson
  projects:
    - name: zmk
      remote: jamesramsay
      revision: develop
      import: app/west.yml
  self:
    path: config
```
